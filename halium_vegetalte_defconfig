## halium_vegetalte_defconfig
```kconfig
# HALIUM MODS
CONFIG_SECURITY_YAMA_STACKED=y
CONFIG_BT_HCIUART=y
CONFIG_TMPFS_POSIX_ACL=y
CONFIG_BT_HCIUART_H4=y
CONFIG_DUMMY=n
CONFIG_SECURITY_YAMA=y
CONFIG_SECURITY_SELINUX_BOOTPARAM=y
CONFIG_PID_NS=y
CONFIG_IPC_NS=y
CONFIG_CGROUP_MEM_RES_CTLR_KMEM=y
CONFIG_NLS_UTF8=y
CONFIG_FW_LOADER_USER_HELPER=y
CONFIG_NETFILTER_XT_MATCH_NFACCT=y
CONFIG_RTC_DRV_CMOS=y
CONFIG_CGROUP_MEM_RES_CTLR_SWAP=y
CONFIG_AUTOFS4_FS=y
CONFIG_HIDRAW=y
CONFIG_FANOTIFY=y
CONFIG_MEMCG_SWAP=y
CONFIG_DEVTMPFS=y
CONFIG_MEMCG=y
CONFIG_FHANDLE=y
CONFIG_CGROUP_PERF=y
CONFIG_BLK_CGROUP=y
CONFIG_UTS_NS=y
CONFIG_DEVTMPFS_MOUNT=y
CONFIG_CHECKPOINT_RESTORE=y
CONFIG_SYSVIPC=y
CONFIG_AUDIT=n
CONFIG_TMPFS_XATTR=y
CONFIG_CGROUP_MEM_RES_CTLR=y
CONFIG_NET_CLS_CGROUP=y
CONFIG_SCHED_DEBUG=y
CONFIG_IKCONFIG_PROC=y
CONFIG_NETFILTER_NETLINK_ACCT=y
CONFIG_WATCHDOG_NOWAYOUT=y
CONFIG_NETPRIO_CGROUP=y
CONFIG_CGROUP_DEVICE=y
CONFIG_MEMCG_KMEM=y
# HALIUM MODS END
```
